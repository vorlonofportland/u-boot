## board/solidrun/mx6_c1/Kconfig
```kconfig
if TARGET_MX6_C1

config SYS_CPU
	string
	default "armv7"

config SYS_BOARD
	string
	default "mx6_c1"

config SYS_VENDOR
	string
	default "solidrun"

config SYS_SOC
	string
	default "mx6"

config SYS_CONFIG_NAME
	string
	default "mx6_c1"

endif
```

## board/solidrun/mx6_cubox-i/Kconfig
```kconfig
if TARGET_MX6_CUBOX_I

config SYS_CPU
	string
	default "armv7"

config SYS_BOARD
	string
	default "mx6_cubox-i"

config SYS_VENDOR
	string
	default "solidrun"

config SYS_SOC
	string
	default "mx6"

config SYS_CONFIG_NAME
	string
	default "mx6_cubox-i"

endif
```

## configs/mx6_c1dl_defconfig
```kconfig
CONFIG_SYS_EXTRA_OPTIONS="IMX_CONFIG=board/solidrun/mx6_c1/mx6_c1dl.cfg,MX6DL,DDR_MB=1024"
+S:CONFIG_ARM=y
+S:CONFIG_TARGET_MX6_C1=y
```

## configs/mx6_c1solo_defconfig
```kconfig
CONFIG_SYS_EXTRA_OPTIONS="IMX_CONFIG=board/solidrun/mx6_c1/mx6_c1solo.cfg,MX6S,DDR_MB=512"
+S:CONFIG_ARM=y
+S:CONFIG_TARGET_MX6_C1=y
```

## configs/mx6_cubox-i2ultra_defconfig
```kconfig
CONFIG_SYS_EXTRA_OPTIONS="IMX_CONFIG=board/solidrun/mx6_c1/mx6_c1d.cfg,MX6Q,DDR_MB=1024"
+S:CONFIG_ARM=y
+S:CONFIG_TARGET_MX6_CUBOX_I=y
```

## configs/mx6_cubox-i_defconfig
```kconfig
CONFIG_SPL=y
CONFIG_SYS_EXTRA_OPTIONS="IMX_CONFIG=board/solidrun/mx6_cubox-i/imx6image.cfg,MX6QDL,FSL_ENV_IN_MMC"
+S:CONFIG_ARM=y
+S:CONFIG_TARGET_MX6_CUBOX_I=y
```
